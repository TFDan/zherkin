## boards/shields/zherkin/Kconfig.defconfig
```kconfig
if SHIELD_ZHERKIN

config ZMK_USB
	default y

#config ZMK_ZHERKIN
#    default "Zherkin"
config ZMK_KEYBOARD_NAME
    default "Zherkin"
endif

if ZMK_BACKLIGHT

config PWM
    default y

config LED_PWM
    default y

endif # ZMK_BACKLIGHT
```
